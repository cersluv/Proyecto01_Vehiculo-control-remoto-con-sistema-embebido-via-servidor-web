## Yocto/conf/bblayers.conf
```bitbake
# POKY_BBLAYERS_CONF_VERSION is increased each time build/conf/bblayers.conf
# changes incompatibly
POKY_BBLAYERS_CONF_VERSION = "2"

BBPATH = "${TOPDIR}"
BBFILES ?= ""

BBLAYERS ?= " \
  /home/cers/Desktop/poky-scarthgap-5.0.10/meta \
  /home/cers/Desktop/poky-scarthgap-5.0.10/meta-poky \
  /home/cers/Desktop/poky-scarthgap-5.0.10/meta-yocto-bsp \
  /home/cers/Desktop/poky-scarthgap-5.0.10/meta-raspberrypi \
  /home/cers/Desktop/poky-scarthgap-5.0.10/meta-webcam \
"
```
